#include <ESP8266WiFi.h>
#include <WiFiClient.h> 
#include <ESP8266HTTPClient.h>
#include <ESP8266WebServer.h>
#include <SPI.h>
#include <SD.h>
#include "Adafruit_Thermal.h"
//#include "ubrick.h"



#define adaqrcode_width  135
#define adaqrcode_height 135

static const PROGMEM uint8_t adaqrcode_data[18225]= {
  0x00,0x00,0x00,0x00,0x00,0x00,0x00,0x00,0x00,0x00,0x00,0x00,0x00,0x00,0x00,0x00,0x00,
  0x00,0x00,0x00,0x00,0x00,0x00,0x00,0x00,0x00,0x00,0x00,0x00,0x00,0x00,0x00,0x00,0x00,
  0x00,0x00,0x00,0x00,0x00,0x00,0x00,0x00,0x00,0x00,0x00,0x00,0x00,0x00,0x00,0x00,0x00,
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  0x00,0x00,0x00,0x00,0x00,0x00,0x00,0x00,0x00,0x00,0x00,0x00,0x00,0x00,0x00,0x00,0x00
};














#include <SoftwareSerial.h>
#define TX_PIN 4 // Arduino transmit  YELLOW WIRE  labeled RX on printer
#define RX_PIN 5 // Arduino receive   GREEN WIRE   labeled TX on printer

#define BUTTON 10
#define QUOTE "you found the test quote by random. nice! you deserve a gold star, but i dont have one only the paper your reading this of"


SoftwareSerial mySerial(RX_PIN, TX_PIN); // Declare SoftwareSerial obj first
Adafruit_Thermal printer(&mySerial);     // Pass addr to printer constructor

const int chipSelect = 4;

/* Set these to your desired credentials. */
const char *ssid = "brickThermalQuote";
const char *password = "eenbaksteen";
unsigned long i = 0;
unsigned long amountOfQuotes;
String quoteS;
String quoteP;
File myFile;

ESP8266WebServer server(80);

/* Just a little test message.  Go to http://192.168.4.1 in a web browser
 * connected to this access point to see it.
 */
void client_status() {
 
  unsigned char number_client;
  struct station_info *stat_info;
  
  struct ip4_addr *IPaddress;
  IPAddress address;
  int i=1;
  
  number_client= wifi_softap_get_station_num();
  stat_info = wifi_softap_get_station_info();
  
  Serial.print(" Total CC : ");
  Serial.println(number_client);
  
    while (stat_info != NULL) {
    
      IPaddress = &stat_info->ip;
      address = IPaddress->addr;
      
      Serial.print("client : ");
      
      Serial.print(i);
      Serial.print("/ IP : ");
      Serial.print((address));
      Serial.print("/ MAC : ");
      
      Serial.print(stat_info->bssid[0],HEX);Serial.print(" ");
      Serial.print(stat_info->bssid[1],HEX);Serial.print(" ");
      Serial.print(stat_info->bssid[2],HEX);Serial.print(" ");
      Serial.print(stat_info->bssid[3],HEX);Serial.print(" ");
      Serial.print(stat_info->bssid[4],HEX);Serial.print(" ");
      Serial.print(stat_info->bssid[5],HEX);Serial.print(" ");
      
      stat_info = STAILQ_NEXT(stat_info, next);
      i++;
      Serial.println();
    }
}

void handleRoot() {
	server.send(200, "text/html", "<!DOCTYPE html><html><head><meta name=\'viewport\' content=\'width=device-width, initial-scale=1\'><link rel=\'icon\' href=\'data:,\'><style>html { font-family: Helvetica; display: inline-block; margin: 0px auto; text-align: center;}.button { background-color: #195B6A; border: none; color: white; padding: 16px 40px;text-decoration: none; font-size: 30px; margin: 2px; cursor: pointer;}.button2 {background-color: #77878A;}</style></head><body><h1>13r1ckz Quote webserver</h1><h2>Submit your quote:</h2><form action='http://192.168.4.1/submit' method='POST'></br><input type='message' name='message' style='width:100%;' maxlength='140'><br><input type='submit'></form></body></html>");
}

void handleSubmit(){
  
  client_status();
  if (server.args() > 0 ) {
    for ( uint8_t i = 0; i < server.args(); i++ ) {
      if (server.argName(i) == "message") {
        quoteS = " ";
        quoteS = server.arg("message");
        myFile = SD.open("quotes.txt", FILE_WRITE);
        myFile.println(quoteS);
        Serial.print(quoteS);
        myFile.close();
      }
   }
}
Serial.println(" ");
//********************thought************************
//***************************************************
//keep track of the amount of quotes vaia a file.
//first reading the file on the falue then add one.
//***************************************************
//***************************************************
//myFile = SD.open("quotesamount.txt", FILE_READ);
//myFile.seek(0);
//amountOfQuotes = myFile.read();
//Serial.println(amountOfQuotes);
//myFile.close();
//myFile = SD.open("quotesamount.txt", FILE_WRITE);
//myFile.seek(0);
//myFile.write((amountOfQuotes +1));
//myFile.close();
  server.send(200, "text/html", "<!DOCTYPE html><html><head><meta name=\'viewport\' content=\'width=device-width, initial-scale=1\'><link rel=\'icon\' href=\'data:,\'><style>html { font-family: Helvetica; display: inline-block; margin: 0px auto; text-align: center;}.button { background-color: #195B6A; border: none; color: white; padding: 16px 40px;text-decoration: none; font-size: 30px; margin: 2px; cursor: pointer;}.button2 {background-color: #77878A;}</style></head><body><h1>13r1ckz Quote webserver</h1><h2>Thank you for your submision</h2><p>get your random quote at the Innsecure assemblie</p></body></html>");
//tnx
  }




void setup() {
	Serial.begin(115200);
  pinMode(BUTTON, INPUT);
	mySerial.begin(9600);  // Initialize SoftwareSerial
  printer.begin();        // Init printer (same regardless of serial type)
  printer.justify('L'); 
	Serial.println();
	Serial.print("Configuring access point...");
  printer.println(F("Configuring access point..."));
	/* You can remove the password parameter if you want the AP to be open. */
  WiFi.mode(WIFI_AP); 
	WiFi.softAP(ssid, password);
  myFile = SD.open("quotesamount.txt", FILE_WRITE);
  myFile.close();
	IPAddress myIP = WiFi.softAPIP();
	Serial.print("AP IP address: ");
  printer.println(F("AP IP address: "));
	Serial.println(myIP);
  printer.println(myIP);
  server.on("/", handleRoot);
  server.on("/submit", handleSubmit);
	server.begin();
	Serial.println("HTTP server started");
  printer.println(F("HTTP server started"));
  
  printer.sleep();      
  delay(1000);         
  printer.wake();      
  printer.setDefault();
  //printer.printBitmap(adaqrcode_width, adaqrcode_height, adaqrcode_data);  //need edit naar qr die aan het netwerk connect
  Serial.println("https://13r1ckz.com/");
  printer.println(F("13r1ckz.com"));
  printer.printBitmap(adaqrcode_width, adaqrcode_height, adaqrcode_data);
  //yield(); //dsklafjdkljfajfkljadsfkljasfjdfklfjfjlfalfjefjeilfjefjelfjejfejfsefj;daklkj;lfsjdskjlafskj;lafsefgkjldkhulgrgrsgrsgrsgrgrsrskjgrkjhsgkjhrghrkjghrgkjhrgkshrkghrglhr

 Serial.print("Initializing SD card...");
 printer.println(F("Initializing SD card..."));

  // see if the card is present and can be initialized:
  if (!SD.begin(chipSelect)) {
    Serial.println("Card failed, or not present");
    printer.println(F("Card failed, or not present"));
   // don't do anything more:
    while (1);
  }
  Serial.println("card initialized.");
  printer.println(F("card initialized"));
  printer.feed(2);
  printer.setDefault();
  printer.sleep();
  
  //myFile = SD.open("quotes.txt", FILE_WRITE);
}

void loop() {
	server.handleClient();
  if(digitalRead(BUTTON) == HIGH){
    printer.wake(); 
    printer.setDefault();
    unsigned long counter = 0;
    unsigned long j;  
    char character;
    char charracter;
    unsigned long randRead;
    Serial.print("from sd: ");
    Serial.println(i);
    myFile = SD.open("quotes.txt", FILE_READ);
    while (myFile.available()) {
      character = myFile.read();
        if(character == '\n'){
        counter++;
        }
        j++;
    }
    //myFile.close();
    Serial.print("Amount of lines : ");
    Serial.println(counter);
    printer.print("Amount of quotes: ");
    printer.println(counter);
    randRead = random(counter);
    Serial.print("Random line : ");
    Serial.println(randRead);
    printer.print("You got quote nr: ");
    printer.println(randRead);
    myFile.seek(0);
    j = 0;
    //myFile = SD.open("quotes.txt", FILE_READ);
    while ((character = myFile.read()) != -1) {
      if(j ==  randRead){
        if(character == '\n'){
        break;
        }
        Serial.print(character);
        printer.print(character);
      }
      if(character == '\n'){
        j++;
      }
    }
    myFile.close();
    Serial.println(" ");
    delay(300);
    i++;
    printer.feed(1);
    printer.sleep();      
    delay(100);         
    printer.wake();      
    printer.setDefault();
      printer.printBitmap(adaqrcode_width, adaqrcode_height, adaqrcode_data);
   // printer.printBitmap(brickz_width, brickz_height, br1ckz);
    printer.feed(2); 
    printer.sleep();
   }
}

